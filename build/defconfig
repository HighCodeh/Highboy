## build/defconfig
```kconfig
CONFIG_ESPTOOLPY_FLASHSIZE_16MB=y
CONFIG_PARTITION_TABLE_TWO_OTA=y
CONFIG_BT_ENABLED=y
CONFIG_BT_NIMBLE_ENABLED=y
CONFIG_BT_NIMBLE_DEBUG=y
CONFIG_BT_NIMBLE_DYNAMIC_SERVICE=y
CONFIG_BT_NIMBLE_TRANSPORT_EVT_SIZE=70
CONFIG_BT_NIMBLE_HS_FLOW_CTRL=y
CONFIG_BT_NIMBLE_MAX_PERIODIC_SYNCS=0
CONFIG_BT_NIMBLE_BLUFI_ENABLE=y
CONFIG_BT_NIMBLE_HID_SERVICE=y
CONFIG_BT_NIMBLE_ENC_ADV_DATA=y
CONFIG_BT_NIMBLE_HIGH_DUTY_ADV_ITVL=y
CONFIG_I2S_SUPPRESS_DEPRECATE_WARN=y
CONFIG_OPENTHREAD_RX_ON_WHEN_IDLE=y
```
