#include "st7789.h"
#include <string.h>
#include <math.h>
#include "driver/gpio.h"
#include "esp_heap_caps.h"
#include "freertos/task.h"
#include "esp_log.h"

// Comandos do controlador ST7789
#define ST7789_CMD_SWRESET 0x01  // Software reset
#define ST7789_CMD_SLPOUT  0x11  // Sleep out
#define ST7789_CMD_COLMOD  0x3A  // Pixel Format Set (definir formato de pixel)
#define ST7789_CMD_MADCTL  0x36  // Memory Data Access Control (orientação)
#define ST7789_CMD_INVOFF  0x20  // Display Inversion OFF
#define ST7789_CMD_INVON   0x21  // Display Inversion ON
#define ST7789_CMD_NORON   0x13  // Normal Display Mode ON
#define ST7789_CMD_DISPON  0x29  // Display ON
#define ST7789_CMD_CASET   0x2A  // Column Address Set (definir coluna)
#define ST7789_CMD_RASET   0x2B  // Row Address Set (definir linha)
#define ST7789_CMD_RAMWR   0x2C  // Memory Write (escrever memória)
#define ST7789_CMD_RAMCTRL 0xB0  // RAM Control (controle de RAM)
static int text_size = 1; // 1x padrão
static int dirty_x0 = 240, dirty_y0 = 240;
static int dirty_x1 = 0, dirty_y1 = 0;





static uint16_t offset_x = ST7789_X_OFFSET;
static uint16_t offset_y = ST7789_Y_OFFSET;
static spi_device_handle_t spi_dev;

// Fonte básica 5x7 (ASCII 32 a 127): cada caractere ocupa 5 bytes (colunas de 7 pixels)
static const uint8_t font5x7[96][5] = {
    // [0] = ' ' (espaço, código 32)
    {0x00, 0x00, 0x00, 0x00, 0x00}, // ' ' (espaço)
    {0x00, 0x00, 0x5F, 0x00, 0x00}, // '!'
    {0x00, 0x07, 0x00, 0x07, 0x00}, // '"'
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    {0x02, 0x01, 0x02, 0x04, 0x02}  // '~'
    // (Del 0x7F não representado – pode ser definido como 0x00 se necessário)
};

// Logo DVD monocromático 48x24 pixels (1 bit por pixel)
const uint8_t dvd_logo_48x24[] = {0x07,0xff,0xf8,0x03,0xff,0x00,0x0f,0xff,0xfc,0x0f,0xff,0xe0,0x0f,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0x00,0x00};


// Dados de exemplo de ícones (monocromáticos 1-bit)
const uint8_t octo[] = {0x00,0x00,0x00,0x00,0x00,0x00,0x00,0x00,0x00,0x00,0x00,0x00,0x00,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0x00,0x00};


const uint8_t octor[] = {0x00,0x00,0x00,0x00,0x00,0x00,0x00,0x00,0x00,0x00,0x00,0x00,0x00,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0x00,0x00};

const uint8_t  bat[] = {0x00,0x00,0x00,0x0f,0xff,0xfe,0x10,0x00,0x01,0x16,0xdb,0x6d,0x76,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0x00,0x00};

const uint8_t wifi[] = {0x01,0xf0,0x00,0x07,0xfc,0x00,0x1e,0x0f,0x00,0x39,0xf3,0x80,0x77,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0x00,0x00};

const uint8_t ble[] = {0x07,0xc0,0x1f,0xf0,0x3e,0xf8,0x7e,0x7c,0x76,0xbc,0xfa,0xde,0xfc,0xbe,0xfe,0x7e,0xfc,0xbe,0xfa,0xde,0x76,0xbc,0x7e,0x7c,0x3e,0xf8,0x1f,0xf0,0x07,0xc0};

const uint8_t ant[] = {0x7f,0xff,0xc0,0x80,0x00,0x20,0x88,0x02,0x20,0x92,0x49,0x20,0x94,0xe5,0x20,0x94,0xe5,0x20,0x92,0x49,0x20,0x88,0x42,0x20,0x80,0x40,0x20,0x80,0x00,0x20,0x7f,0xff,0xc0};

const uint8_t image_wi_fi_bits[] = {0x00,0x00,0x00,0x00,0x00,0x00,0x00,0x00,0x00,0x00,0x00,0x00,0x00,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0x00,0x00};

const uint8_t image_bluetooth_bits[] = {0x00,0x1c,0x00,0x00,0x00,0x1e,0x00,0x00,0x00,0x1f,0x00,0x00,0x00,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0x00,0x00};
const uint8_t image_nfc_bits[] = {0x00,0x00,0x00,0x00,0x00,0x00,0x00,0x00,0x1f,0xff,0xdf,0xf8,0x3f,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0x00,0x00};

const uint8_t image_infravermelho_bits[] = {0xfe,0x00,0x00,0x00,0xff,0x00,0x00,0x00,0xff,0x80,0x00,0x00,0xff,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0x00,0x00};



// Função auxiliar: envia um comando de 8 bits via SPI (DC=0)
static esp_err_t send_cmd(uint8_t cmd) {
    spi_transaction_t t = {0};
    t.length = 8;                    // 8 bits no buffer
    t.tx_buffer = &cmd;
    gpio_set_level(ST7789_PIN_DC, 0);
    return spi_device_polling_transmit(spi_dev, &t);
}

// Função auxiliar: envia dados de comprimento `len` via SPI (DC=1)
static esp_err_t send_data(const void *data, int len) {
    if (len <= 0) return ESP_OK;
    spi_transaction_t t = {0};
    t.length = len * 8;
    t.tx_buffer = data;
    gpio_set_level(ST7789_PIN_DC, 1);
    return spi_device_polling_transmit(spi_dev, &t);
}

// Função auxiliar: define a janela (regiões CASET/RASET) e prepara para escrita (RAMWR)
static void set_addr_window(int x, int y, int w, int h) {
    uint16_t x0 = x + offset_x;
    uint16_t y0 = y + offset_y;
    uint16_t x1 = x0 + w - 1;
    uint16_t y1 = y0 + h - 1;
    uint8_t data[4];

    // Colunas (CASET)
    data[0] = x0 >> 8;
    data[1] = x0 & 0xFF;
    data[2] = x1 >> 8;
    data[3] = x1 & 0xFF;
    send_cmd(ST7789_CMD_CASET);
    send_data(data, 4);

    // Linhas (RASET)
    data[0] = y0 >> 8;
    data[1] = y0 & 0xFF;
    data[2] = y1 >> 8;
    data[3] = y1 & 0xFF;
    send_cmd(ST7789_CMD_RASET);
    send_data(data, 4);

    // Preparar para escrever na RAM (RAMWR)
    send_cmd(ST7789_CMD_RAMWR);
}

// Função auxiliar: preenche um quarto de círculo de raio `r` (usado para cantos arredondados preenchidos)
static void fill_quarter_circle(int cx, int cy, int r, uint16_t color, int quadrant) {
    int r_sq = r * r;
    for (int dy = 0; dy < r; ++dy) {
        for (int dx = 0; dx < r; ++dx) {
            if (dx * dx + dy * dy <= r_sq) {
                int px = cx, py = cy;
                switch (quadrant) {
                    case 1: px = cx - dx; py = cy - dy; break; // canto superior-esquerdo
                    case 2: px = cx + dx; py = cy - dy; break; // canto superior-direito
                    case 3: px = cx - dx; py = cy + dy; break; // canto inferior-esquerdo
                    case 4: px = cx + dx; py = cy + dy; break; // canto inferior-direito
                }
                st7789_draw_pixel(px, py, color);
            }
        }
    }
}

// Função auxiliar: desenha o contorno (borda) de um quarto de círculo de raio `r` (usado para cantos arredondados da borda)
static void draw_quarter_circle(int cx, int cy, int r, uint16_t color, int quadrant) {
    if (r <= 0) return;
    // Bresenham para círculo - traça apenas pontos do quadrante especificado
    int x = 0;
    int y = r;
    int f = 1 - r;
    int ddF_x = 1;
    int ddF_y = -2 * r;

    // Desenha os pontos extremos do quadrante (pontos terminais nas bordas)
    if (quadrant == 1 || quadrant == 2) {
        // Topo do círculo (acima do centro)
        st7789_draw_pixel(cx, cy - r, color);
    } else if (quadrant == 3 || quadrant == 4) {
        // Base do círculo (abaixo do centro)
        st7789_draw_pixel(cx, cy + r, color);
    }
    if (quadrant == 1 || quadrant == 3) {
        // Esquerda do círculo (à esquerda do centro)
        st7789_draw_pixel(cx - r, cy, color);
    } else if (quadrant == 2 || quadrant == 4) {
        // Direita do círculo (à direita do centro)
        st7789_draw_pixel(cx + r, cy, color);
    }

    // Traça o arco do quadrante pixel a pixel
    while (x < y) {
        if (f >= 0) {
            y--;
            ddF_y += 2;
            f += ddF_y;
        }
        x++;
        ddF_x += 2;
        f += ddF_x;
        // Desenha apenas os pontos pertencentes ao quadrante selecionado
        if (quadrant == 1) {
            st7789_draw_pixel(cx - x, cy - y, color);
            if (x != y) st7789_draw_pixel(cx - y, cy - x, color);
        } else if (quadrant == 2) {
            st7789_draw_pixel(cx + x, cy - y, color);
            if (x != y) st7789_draw_pixel(cx + y, cy - x, color);
        } else if (quadrant == 3) {
            st7789_draw_pixel(cx - x, cy + y, color);
            if (x != y) st7789_draw_pixel(cx - y, cy + x, color);
        } else if (quadrant == 4) {
            st7789_draw_pixel(cx + x, cy + y, color);
            if (x != y) st7789_draw_pixel(cx + y, cy + x, color);
        }
    }
}


void st7789_set_rotation(uint8_t rotation) {
    uint8_t madctl = 0;
    rotation %= 4;

    switch (rotation) {
        case 0:
            madctl = 0x00;
            offset_x = 0;
            offset_y = 0;
            break;
        case 1:
            madctl = 0x60;
            offset_x = 0;
            offset_y = 0;
            break;
        case 2:
            madctl = 0xC0;
            offset_x = 0;
            offset_y = 80;
            break;
        case 3:
            madctl = 0xA0;
            offset_x = 0;
            offset_y = 0;
            break;
    }

    send_cmd(ST7789_CMD_MADCTL);
    send_data(&madctl, 1);
}


// Inicializa o display ST7789 (configura SPI e executa sequência de inicialização)
void st7789_init(void) {
    // >>> NÃO chama mais spi_bus_initialize() aqui <<<

    spi_device_interface_config_t devcfg = {
        .clock_speed_hz = 40 * 1000 * 1000,  // 40 MHz
        .mode = 0,                           // SPI mode 0
        .spics_io_num = ST7789_PIN_CS,      // CS do display
        .queue_size = 1,
        .flags = SPI_DEVICE_HALFDUPLEX
    };

    // Adiciona o display à SPI3 (host já deve estar inicializado externamente)
    spi_bus_add_device(SPI3_HOST, &devcfg, &spi_dev);

    // Configura os pinos de controle como saída
    gpio_set_direction(ST7789_PIN_DC, GPIO_MODE_OUTPUT);
    gpio_set_direction(ST7789_PIN_RST, GPIO_MODE_OUTPUT);
    gpio_set_direction(ST7789_PIN_BL, GPIO_MODE_OUTPUT);

    // Reset por hardware no display
    gpio_set_level(ST7789_PIN_RST, 0);
    vTaskDelay(pdMS_TO_TICKS(50));
    gpio_set_level(ST7789_PIN_RST, 1);
    vTaskDelay(pdMS_TO_TICKS(50));

    // Inicialização do ST7789
    send_cmd(ST7789_CMD_SWRESET);    
    vTaskDelay(pdMS_TO_TICKS(150));
    send_cmd(ST7789_CMD_SLPOUT);     
    vTaskDelay(pdMS_TO_TICKS(120));

    uint8_t color_mode = 0x55;       
    send_cmd(ST7789_CMD_COLMOD);
    send_data(&color_mode, 1);
    vTaskDelay(pdMS_TO_TICKS(10));

    uint8_t madctl = 0x00;           
    send_cmd(ST7789_CMD_MADCTL);
    send_data(&madctl, 1);

    uint8_t ramctrl_data[2] = {0x00, 0xC8};
    send_cmd(ST7789_CMD_RAMCTRL);
    send_data(ramctrl_data, 2);
    vTaskDelay(pdMS_TO_TICKS(10));

    send_cmd(ST7789_CMD_INVON);  
    vTaskDelay(pdMS_TO_TICKS(10));
    send_cmd(ST7789_CMD_NORON);  
    vTaskDelay(pdMS_TO_TICKS(10));
    send_cmd(ST7789_CMD_DISPON); 
    vTaskDelay(pdMS_TO_TICKS(100));
    st7789_set_rotation(4);  

    gpio_set_level(ST7789_PIN_BL, 1);
    st7789_fill_screen(ST7789_COLOR_BLACK);
}


// Liga ou desliga o backlight do display
void st7789_set_backlight(bool on) {
    gpio_set_level(ST7789_PIN_BL, on ? 1 : 0);
}

// Preenche a tela inteira com a cor especificada
void st7789_fill_screen(uint16_t color) {
    st7789_draw_rect(0, 0, ST7789_WIDTH, ST7789_HEIGHT, color);
}



// Desenha um pixel na posição (x, y) com a cor especificada
void st7789_draw_pixel(int x, int y, uint16_t color) {
    // Verifica se as coordenadas estão dentro da área visível
    if ((uint16_t)x >= ST7789_WIDTH || (uint16_t)y >= ST7789_HEIGHT) {
        return;
    }

    // Define a área de escrita como um único pixel
    set_addr_window(x, y, 1, 1);

    // Converte a cor para bytes no formato little-endian (LSB primeiro)
    uint8_t data[2];
    data[0] = color & 0xFF;       // LSB
    data[1] = (color >> 8) & 0xFF; // MSB

    // Envia os dados da cor para o display
    send_data(data, 2);
}


// Desenha uma linha reta do ponto (x0,y0) até (x1,y1) usando o algoritmo de Bresenham
void st7789_draw_line(int x0, int y0, int x1, int y1, uint16_t color) {
    // Algoritmo de Bresenham para rasterizar linhas
    int dx = abs(x1 - x0);
    int dy = abs(y1 - y0);

    int step_x = (x0 < x1) ? 1 : -1;
    int step_y = (y0 < y1) ? 1 : -1;

    int err = dx - dy;

    while (true) {
        st7789_draw_pixel(x0, y0, color);

        // Verifica se o ponto final foi alcançado
        if (x0 == x1 && y0 == y1) break;

        int err2 = 2 * err;

        // Ajusta o erro e avança no eixo x
        if (err2 > -dy) {
            err -= dy;
            x0 += step_x;
        }

        // Ajusta o erro e avança no eixo y
        if (err2 < dx) {
            err += dx;
            y0 += step_y;
        }
    }
}


// Desenha um retângulo com cantos arredondados (apenas borda)
// Desenha um retângulo com cantos arredondados (somente borda)
void st7789_draw_round_rect(int x, int y, int w, int h, int r, uint16_t color) {
    // Validação de dimensões
    if (w <= 0 || h <= 0) return;

    // Ajuste do raio para não ultrapassar a metade da largura ou altura
    if (r > w / 2) r = w / 2;
    if (r > h / 2) r = h / 2;

    if (r == 0) {
        // Sem raio: desenha retângulo normal (apenas borda)
        st7789_draw_line(x,         y,         x + w - 1, y,         color); // topo
        st7789_draw_line(x,         y + h - 1, x + w - 1, y + h - 1, color); // base
        st7789_draw_line(x,         y,         x,         y + h - 1, color); // esquerda
        st7789_draw_line(x + w - 1, y,         x + w - 1, y + h - 1, color); // direita
        return;
    }

    // Bordas retas (entre os cantos)
    st7789_draw_line(x + r,         y,         x + w - r - 1, y,         color); // superior
    st7789_draw_line(x + r,         y + h - 1, x + w - r - 1, y + h - 1, color); // inferior
    st7789_draw_line(x,             y + r,     x,             y + h - r - 1, color); // esquerda
    st7789_draw_line(x + w - 1,     y + r,     x + w - 1,     y + h - r - 1, color); // direita

    // Cantos arredondados (arcos de 90°)
    draw_quarter_circle(x + r,         y + r,         r, color, 1); // superior-esquerdo
    draw_quarter_circle(x + w - r - 1, y + r,         r, color, 2); // superior-direito
    draw_quarter_circle(x + r,         y + h - r - 1, r, color, 3); // inferior-esquerdo
    draw_quarter_circle(x + w - r - 1, y + h - r - 1, r, color, 4); // inferior-direito
}


// Desenha um retângulo preenchido com a cor especificada (coordenadas e dimensão limitadas à tela)

void st7789_draw_rect(int x, int y, int w, int h, uint16_t color) {
    // Verifica e ajusta para não ultrapassar os limites da tela
    if (x < 0) { w += x; x = 0; }
    if (y < 0) { h += y; y = 0; }
    if (x >= ST7789_WIDTH || y >= ST7789_HEIGHT) return;

    if (x + w > ST7789_WIDTH)  w = ST7789_WIDTH  - x;
    if (y + h > ST7789_HEIGHT) h = ST7789_HEIGHT - y;
    if (w <= 0 || h <= 0) return;

    // Define a janela de escrita no display
    set_addr_window(x, y, w, h);

    size_t pixel_count = (size_t)w * h;
    size_t byte_count = pixel_count * sizeof(uint16_t);

    // Tenta alocar buffer DMA para preenchimento rápido
    uint16_t *buffer = heap_caps_malloc(byte_count, MALLOC_CAP_DMA);
    if (buffer) {
        // Preenche buffer com a cor desejada
        for (size_t i = 0; i < pixel_count; ++i) {
            buffer[i] = color;
        }

        // Envia em blocos para evitar transações muito grandes
        const uint8_t *data = (uint8_t *)buffer;
        size_t remaining = byte_count;

        while (remaining > 0) {
            size_t chunk = (remaining > ST7789_MAX_CHUNK_BYTES) ? ST7789_MAX_CHUNK_BYTES : remaining;
            send_data(data, chunk);
            data += chunk;
            remaining -= chunk;
        }

        heap_caps_free(buffer);
    } else {
        // Fallback: sem buffer, desenha pixel a pixel (lento)
        for (int yy = y; yy < y + h; ++yy) {
            for (int xx = x; xx < x + w; ++xx) {
                st7789_draw_pixel(xx, yy, color);
            }
        }
    }
}



// Função: st7789_draw_char (sem bg_color)
// Desenha um caractere ASCII (5x7) na posição (x, y)
void st7789_draw_char(int x, int y, char c, uint16_t color) {
    // Substitui caracteres fora da faixa visível por espaço
    if ((uint8_t)c < 32 || (uint8_t)c > 126) {
        c = ' ';
    }

    // Obtém os dados do caractere na fonte 5x7
    const uint8_t *glyph = font5x7[(uint8_t)c - 32];

    // Itera por cada coluna do caractere (5 colunas)
    for (int col = 0; col < 5; col++) {
        uint8_t column_bits = glyph[col];

        // Itera por cada bit da coluna (7 linhas)
        for (int row = 0; row < 7; row++) {
            if (column_bits & (1 << row)) {
                st7789_draw_pixel(x + col, y + row, color);
            }
        }
    }
}




// Desenha um botão com borda, preenchimento e texto centralizado (suporta múltiplas linhas)
void st7789_draw_button(int x, int y, int w, int h, const char *label,
    uint16_t text_color, uint16_t fill_color, uint16_t border_color) {
if (w <= 0 || h <= 0) return;

// Desenha a borda do botão
st7789_draw_rect(x, y, w, h, border_color);

// Preenche o interior do botão (se houver espaço útil)
if (w > 2 && h > 2) {
st7789_draw_rect(x + 1, y + 1, w - 2, h - 2, fill_color);
}

if (label == NULL) return;

// === Etapa 1: Contar número de linhas ===
int total_lines = 0;
const char *p = label;
while (*p) {
total_lines++;
while (*p && *p != '\n') p++;
if (*p == '\n') p++;
}

if (total_lines == 0) return;

// === Etapa 2: Calcular posição vertical inicial (centralizada) ===
int text_block_height = total_lines * 7 + (total_lines - 1); // altura total do texto
int y_start = y + 1 + ((h - 2 - text_block_height) / 2);
if (y_start < y + 1) y_start = y + 1;

// === Etapa 3: Renderizar cada linha de texto ===
p = label;
int line_idx = 0;
char line_buf[64];  // até 63 caracteres por linha

while (*p && line_idx < total_lines) {
// Copia linha atual para o buffer
int i = 0;
while (*p && *p != '\n' && i < (int)(sizeof(line_buf) - 1)) {
line_buf[i++] = *p++;
}
line_buf[i] = '\0';
if (*p == '\n') p++;

// Calcula posição horizontal centralizada
int char_count = i;
int text_width = (char_count > 0) ? (char_count * 6 - 1) : 0;
int x_text = x + 1 + ((w - 2 - text_width) / 2);
if (x_text < x + 1) x_text = x + 1;

int y_text = y_start + line_idx * 8;
if (y_text > y + h - 8) break;

st7789_draw_text(x_text, y_text, line_buf, text_color);
line_idx++;
}
}


// Desenha uma imagem colorida (array de pixels 16-bit) de largura w e altura h na posição (x,y)
// Desenha uma imagem (bitmap RGB565) na posição (x, y) com dimensões (w x h)
void st7789_draw_image(int x, int y, int w, int h, const uint16_t *image) {
    // Validação de entrada
    if (!image || w <= 0 || h <= 0) return;

    // Ajuste de coordenadas para garantir que a imagem fique visível
    if (x < 0 || y < 0 || x + w > ST7789_WIDTH || y + h > ST7789_HEIGHT) {
        return;  // Imagem fora dos limites visíveis
    }

    // Define a área de escrita no display
    set_addr_window(x, y, w, h);

    // Envia os dados da imagem (2 bytes por pixel - formato RGB565)
    size_t byte_count = (size_t)w * h * sizeof(uint16_t);
    send_data((const uint8_t *)image, byte_count);
}

// Preenche um retângulo com cantos arredondados com a cor especificada
void st7789_fill_round_rect(int x, int y, int w, int h, int r, uint16_t color) {
    // Preenche o centro retangular
    st7789_draw_rect(x + r, y, w - 2 * r, h, color); // parte central horizontal
    st7789_draw_rect(x, y + r, r, h - 2 * r, color); // esquerda
    st7789_draw_rect(x + w - r, y + r, r, h - 2 * r, color); // direita

    // Preenche os 4 cantos arredondados
    fill_quarter_circle(x + r, y + r, r, color, 1);                   // superior esquerdo
    fill_quarter_circle(x + w - r - 1, y + r, r, color, 2);           // superior direito
    fill_quarter_circle(x + r, y + h - r - 1, r, color, 3);           // inferior esquerdo
    fill_quarter_circle(x + w - r - 1, y + h - r - 1, r, color, 4);   // inferior direito
}


// Desenha um bitmap monocromático (1 bit por pixel) na posição (x, y)
// Pixels com bit '1' são desenhados na cor especificada, '0' são ignorados (transparente)
void st7789_draw_bitmap(int x, int y, const uint8_t *bitmap, int w, int h, uint16_t color) {
    if (!bitmap || w <= 0 || h <= 0) return;

    int bytes_per_row = (w + 7) / 8;

    for (int row = 0; row < h; ++row) {
        for (int col = 0; col < w; ++col) {
            int byte_index = row * bytes_per_row + (col / 8);
            int bit_mask   = 0x80 >> (col % 8);

            if (bitmap[byte_index] & bit_mask) {
                st7789_draw_pixel(x + col, y + row, color);
            }
        }
    }
}


void st7789_write_color(uint16_t color) {
    uint8_t data[2];
    data[0] = color >> 8;       // MSB
    data[1] = color & 0xFF;     // LSB
    send_data(data, 2);         // Envia via SPI
}



void st7789_draw_bitmapRGB(int x, int y, const uint16_t *bitmap, int w, int h) {
    set_addr_window(x, y, w, h);

    int total = w * h;
    uint8_t *buffer = heap_caps_malloc(total * 2, MALLOC_CAP_DMA);
    if (!buffer) return;

    for (int i = 0; i < total; i++) {
        buffer[2 * i]     = bitmap[i] & 0xFF;    // LSB
buffer[2 * i + 1] = bitmap[i] >> 8;      // MSB
    }

    send_data(buffer, total * 2);
    heap_caps_free(buffer);
}



// Desenha uma linha horizontal (reta) na posição (x, y) com largura w
void st7789_draw_hline(int x, int y, int w, uint16_t color) {
    if (w <= 0 || y < 0 || y >= ST7789_HEIGHT) return;

    // Clipping horizontal
    if (x < 0) {
        w += x;
        x = 0;
    }
    if (x + w > ST7789_WIDTH) {
        w = ST7789_WIDTH - x;
    }
    if (w <= 0) return;

    // Define a área de escrita para a linha
    set_addr_window(x, y, w, 1);

    // Preenche um buffer com a cor da linha
    uint16_t buffer[w];
    for (int i = 0; i < w; i++) {
        buffer[i] = color;
    }

    // Envia os dados da linha (w pixels * 2 bytes)
    send_data((uint8_t *)buffer, w * sizeof(uint16_t));
}



// Preenche um círculo sólido com centro (x0, y0) e raio r
void st7789_fill_circle(int x0, int y0, int r, uint16_t color) {
    if (r <= 0) return;

    int x = 0;
    int y = r;
    int d = 3 - 2 * r;

    while (y >= x) {
        // Preenche linhas horizontais simétricas
        st7789_draw_hline(x0 - x, y0 + y, 2 * x + 1, color);
        st7789_draw_hline(x0 - x, y0 - y, 2 * x + 1, color);
        st7789_draw_hline(x0 - y, y0 + x, 2 * y + 1, color);
        st7789_draw_hline(x0 - y, y0 - x, 2 * y + 1, color);

        if (d < 0) {
            d += 4 * x + 6;
        } else {
            d += 4 * (x - y) + 10;
            y--;
        }
        x++;
    }
}

/// Desenha o contorno de um círculo com centro (x0, y0) e raio r
void st7789_draw_circle(int x0, int y0, int r, uint16_t color) {
    if (r <= 0) return;

    int x = 0;
    int y = r;
    int d = 3 - 2 * r;

    while (y >= x) {
        st7789_draw_pixel(x0 + x, y0 + y, color);
        st7789_draw_pixel(x0 - x, y0 + y, color);
        st7789_draw_pixel(x0 + x, y0 - y, color);
        st7789_draw_pixel(x0 - x, y0 - y, color);
        st7789_draw_pixel(x0 + y, y0 + x, color);
        st7789_draw_pixel(x0 - y, y0 + x, color);
        st7789_draw_pixel(x0 + y, y0 - x, color);
        st7789_draw_pixel(x0 - y, y0 - x, color);

        if (d < 0) {
            d += 4 * x + 6;
        } else {
            d += 4 * (x - y) + 10;
            y--;
        }
        x++;
    }
}


// Draw a triangle
// Desenha o contorno de um triângulo conectando os pontos (x0,y0), (x1,y1), (x2,y2)
void st7789_draw_triangle(int x0, int y0,int x1, int y1,int x2, int y2,uint16_t color) {
// Desenha as três arestas do triângulo
st7789_draw_line(x0, y0, x1, y1, color); // Lado A-B
st7789_draw_line(x1, y1, x2, y2, color); // Lado B-C
st7789_draw_line(x2, y2, x0, y0, color); // Lado C-A
}

// Preenche um triângulo com os vértices (x0,y0), (x1,y1), (x2,y2) com a cor especificada
void st7789_fill_triangle(int x0, int y0,
    int x1, int y1,
    int x2, int y2,
    uint16_t color) {
// Ordena os vértices por coordenada Y (y0 <= y1 <= y2)
if (y0 > y1) { int t; t = y0; y0 = y1; y1 = t; t = x0; x0 = x1; x1 = t; }
if (y1 > y2) { int t; t = y1; y1 = y2; y2 = t; t = x1; x1 = x2; x2 = t; }
if (y0 > y1) { int t; t = y0; y0 = y1; y1 = t; t = x0; x0 = x1; x1 = t; }

// Caso especial: triângulo "plano" (todas as Y iguais)
if (y0 == y2) {
int xmin = x0 < x1 ? (x0 < x2 ? x0 : x2) : (x1 < x2 ? x1 : x2);
int xmax = x0 > x1 ? (x0 > x2 ? x0 : x2) : (x1 > x2 ? x1 : x2);
st7789_draw_hline(xmin, y0, xmax - xmin + 1, color);
return;
}

// Cálculos diferenciais para as arestas
int dx01 = x1 - x0, dy01 = y1 - y0;
int dx02 = x2 - x0, dy02 = y2 - y0;
int dx12 = x2 - x1, dy12 = y2 - y1;

int sa = 0, sb = 0;

int y, a, b, last = (y1 == y2) ? y1 : (y1 - 1);

// Parte superior do triângulo (de y0 até y1)
for (y = y0; y <= last; y++) {
int segment_height01 = dy01 == 0 ? 1 : dy01;
int segment_height02 = dy02 == 0 ? 1 : dy02;

a = x0 + sa / segment_height01;
b = x0 + sb / segment_height02;

sa += dx01;
sb += dx02;

if (a > b) { int t = a; a = b; b = t; }
st7789_draw_hline(a, y, b - a + 1, color);
}

// Reinicia acumuladores para a parte inferior
sa = dx12 * (y - y1);
sb = dx02 * (y - y0);

// Parte inferior do triângulo (de y1 até y2)
for (; y <= y2; y++) {
int segment_height12 = dy12 == 0 ? 1 : dy12;
int segment_height02 = dy02 == 0 ? 1 : dy02;

a = x1 + sa / segment_height12;
b = x0 + sb / segment_height02;

sa += dx12;
sb += dx02;

if (a > b) { int t = a; a = b; b = t; }
st7789_draw_hline(a, y, b - a + 1, color);
}
}


// Define o fator de escala para o texto (mínimo 1x)
void st7789_set_text_size(int size) {
    if (size < 1) {
        size = 1;
    }

    text_size = size;
}



// Desenha um caractere ASCII com escala configurável via text_size
void st7789_draw_char_scaled(int x, int y, char c, uint16_t color) {
    if ((uint8_t)c < 32 || (uint8_t)c > 126) {
        c = '?'; // Substitui caracteres não imprimíveis
    }

    const uint8_t *glyph = font5x7[(uint8_t)c - 32];

    for (int col = 0; col < 5; col++) {
        uint8_t column_bits = glyph[col];

        for (int row = 0; row < 7; row++) {
            if (column_bits & 0x01) {
                int px = x + (col * text_size);
                int py = y + (row * text_size);

                if (text_size == 1) {
                    st7789_draw_pixel(px, py, color);
                } else {
                    st7789_draw_rect(px, py, text_size, text_size, color);
                }
            }
            column_bits >>= 1;
        }
    }
}

// Desenha uma string de texto na posição (x, y), usando o tamanho definido em text_size
void st7789_draw_text(int x, int y, const char *text, uint16_t color) {
    if (!text) return;

    while (*text) {
        st7789_draw_char_scaled(x, y, *text, color);
        x += (6 * text_size); // 5 pixels de caractere + 1 pixel de espaço
        text++;
    }
}


// Desenha um retângulo sólido preenchido na posição (x, y) com largura w e altura h
void st7789_draw_filled_rect(int x, int y, int w, int h, uint16_t color) {
    if (w <= 0 || h <= 0) return;

    // Otimização: use st7789_draw_rect com buffer, se disponível
    for (int j = y; j < y + h; j++) {
        st7789_draw_hline(x, j, w, color);
    }
}

// Desenha texto centralizado horizontalmente em centerX, fixo na coordenada Y
void st7789_draw_text_centered(int centerX, int y, const char *text, uint16_t color) {
    if (!text) return;

    int length = strlen(text);
    int text_width = length * (6 * text_size); // 5px + 1px espaço por caractere
    int x_start = centerX - (text_width / 2);

    st7789_draw_text(x_start, y, text, color);
}

static uint16_t *framebuffer = NULL;

void st7789_mark_dirty(int x, int y, int w, int h) {
    if (x < dirty_x0) dirty_x0 = x;
    if (y < dirty_y0) dirty_y0 = y;
    if (x + w > dirty_x1) dirty_x1 = x + w;
    if (y + h > dirty_y1) dirty_y1 = y + h;
}

#define ST7789_SPI_CHUNK_SIZE (4096) // bytes


void st7789_update_dirty(void) {
    if (!framebuffer) return;
    if (dirty_x1 <= dirty_x0 || dirty_y1 <= dirty_y0) return;

    int w = dirty_x1 - dirty_x0;
  

    for (int y = dirty_y0; y < dirty_y1; y++) {
        set_addr_window(dirty_x0, y, dirty_x1 - 1, y);

        const uint8_t *ptr = (const uint8_t *)&framebuffer[y * ST7789_WIDTH + dirty_x0];
        size_t len = w * sizeof(uint16_t);

        while (len > 0) {
            size_t chunk = len > ST7789_MAX_CHUNK_BYTES ? ST7789_MAX_CHUNK_BYTES : len;
            send_data(ptr, chunk);
            ptr += chunk;
            len -= chunk;
        }
    }

    dirty_x0 = ST7789_WIDTH;
    dirty_y0 = ST7789_HEIGHT;
    dirty_x1 = 0;
    dirty_y1 = 0;
}



void st7789_enable_framebuffer(void) {
    framebuffer = heap_caps_malloc(ST7789_WIDTH * ST7789_HEIGHT * sizeof(uint16_t), MALLOC_CAP_DMA);
    if (framebuffer) {
        memset(framebuffer, 0, ST7789_WIDTH * ST7789_HEIGHT * sizeof(uint16_t));
    } else {
        ESP_LOGE("ST7789", "Erro ao alocar framebuffer!");
    }
}

uint16_t *st7789_get_framebuffer(void) {
    return framebuffer;
}

void st7789_update(void) {
    st7789_draw_bitmapRGB(0, 0, framebuffer, ST7789_WIDTH, ST7789_HEIGHT);
}


void st7789_draw_pixel_fb(int x, int y, uint16_t color) {
    if (!framebuffer) return;
    if (x < 0 || x >= ST7789_WIDTH || y < 0 || y >= ST7789_HEIGHT) return;

    framebuffer[y * ST7789_WIDTH + x] = color;

    if (x < dirty_x0) dirty_x0 = x;
    if (y < dirty_y0) dirty_y0 = y;
    if (x + 1 > dirty_x1) dirty_x1 = x + 1;
    if (y + 1 > dirty_y1) dirty_y1 = y + 1;
}


void st7789_draw_icon(int x, int y, const uint8_t *icon_bits, uint16_t fg, uint16_t bg) {
    for (int j = 0; j < 24; j++) {
        for (int i = 0; i < 24; i++) {
            int byte_index = (j * 24 + i) / 8;
            int bit_index = 7 - (i % 8);
            bool bit = (icon_bits[byte_index] >> bit_index) & 0x01;
            st7789_draw_pixel(x + i, y + j, bit ? fg : bg);
        }
    }
}


void st7789_fill_rect_fb(int x0, int y0, int w, int h, uint16_t color) {
    for (int y = y0; y < y0 + h; y++) {
        for (int x = x0; x < x0 + w; x++) {
            st7789_draw_pixel_fb(x, y, color);
        }
    }
}


void st7789_draw_bitmap_1bit_fb(int x, int y, const uint8_t *bitmap, int w, int h, uint16_t fg, uint16_t bg) {
    for (int j = 0; j < h; j++) {
        for (int i = 0; i < w; i++) {
            int byte_index = (j * w + i) / 8;
            int bit_index = 7 - (i % 8);
            bool pixel = (bitmap[byte_index] >> bit_index) & 0x01;
            st7789_draw_pixel_fb(x + i, y + j, pixel ? fg : bg);
        }
    }
}



void st7789_reset_dirty_rect(void) {
    dirty_x0 = ST7789_WIDTH;
    dirty_y0 = ST7789_HEIGHT;
    dirty_x1 = 0;
    dirty_y1 = 0;
}

void st7789_draw_char_fb(int x, int y, char c, uint16_t color, uint16_t bg_color) {
    if (!framebuffer) return;
    if (x < -5*text_size || x >= ST7789_WIDTH || y < -7*text_size || y >= ST7789_HEIGHT) return;

    if (c < 32 || c > 127) c = 127;
    uint8_t font_index = c - 32;

    for (int i = 0; i < 5; i++) {
        uint8_t line = font5x7[font_index][i];
        for (int j = 0; j < 7; j++) {
            if (line & (1 << (6 - j))) {
                for(int k=0; k<text_size; k++) {
                  for(int l=0; l<text_size; l++) {
                    st7789_draw_pixel_fb(x + i*text_size + k, y + j*text_size + l, color);
                  }
                }
            } else if (bg_color != 0xFFFF) { // Opaque background
                for(int k=0; k<text_size; k++) {
                  for(int l=0; l<text_size; l++) {
                    st7789_draw_pixel_fb(x + i*text_size + k, y + j*text_size + l, bg_color);
                  }
                }
            }
        }
    }
}


void st7789_scroll_text(int x, int y, int offset_y, const char *text, uint16_t color, uint16_t bg_color) {
    st7789_reset_dirty_rect(); 
    int text_len = strlen(text);
    for (int i = 0; i < text_len; i++) {
        st7789_draw_char_fb(x + i * 6 * text_size, y + offset_y, text[i], color, bg_color);  // Assuming 6 pixels width
    }
    st7789_mark_dirty(x, y + offset_y, text_len * 6 * text_size, 8 * text_size); // Update dirty rect
    st7789_update_dirty();
}

